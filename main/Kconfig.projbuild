## main/Kconfig.projbuild
```kconfig
menu "M5Stick board"

choice M5STICKC_BOARD
    prompt "Target board"
    default M5STICK_BOARD_S3 if IDF_TARGET_ESP32S3
    default M5STICKC_BOARD_PLUS
    help
        Select the M5Stick variant used by this firmware.

config M5STICKC_BOARD_PLUS
    bool "M5StickC Plus (4 MB flash)"
    depends on IDF_TARGET_ESP32

config M5STICKC_BOARD_PLUS2
    bool "M5StickC Plus2 (8 MB flash)"
    depends on IDF_TARGET_ESP32

config M5STICK_BOARD_S3
    bool "M5StickS3 (ESP32-S3)"
    depends on IDF_TARGET_ESP32S3

endchoice

endmenu
```

## sdkconfig.defaults.plus
```kconfig
CONFIG_M5STICKC_BOARD_PLUS=y
# CONFIG_M5STICKC_BOARD_PLUS2 is not set
CONFIG_ESPTOOLPY_FLASHSIZE_4MB=y
CONFIG_ESPTOOLPY_HEADER_FLASHSIZE_UPDATE=y
```

## sdkconfig.defaults.plus2
```kconfig
# CONFIG_M5STICKC_BOARD_PLUS is not set
CONFIG_M5STICKC_BOARD_PLUS2=y
CONFIG_ESPTOOLPY_FLASHSIZE_8MB=y
CONFIG_ESPTOOLPY_HEADER_FLASHSIZE_UPDATE=y
```

## sdkconfig.defaults.s3
```kconfig
# CONFIG_M5STICKC_BOARD_PLUS is not set
# CONFIG_M5STICKC_BOARD_PLUS2 is not set
CONFIG_M5STICK_BOARD_S3=y
CONFIG_ESPTOOLPY_FLASHSIZE_8MB=y
CONFIG_ESPTOOLPY_HEADER_FLASHSIZE_UPDATE=y
```
